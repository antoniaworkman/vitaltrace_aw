## CMakeLists.txt
```
# SPDX-License-Identifier: Apache-2.0

cmake_minimum_required(VERSION 3.20.0)
find_package(Zephyr REQUIRED HINTS $ENV{ZEPHYR_BASE})
project(peripheral)

target_sources(app PRIVATE
  src/main.c
  src/ble.c
  src/heart_rate.c
  src/battery.c
  src/heart_rate_pb.c
)

target_include_directories(app PRIVATE include)
```

## prj.conf
```kconfig
# Increased stack due to settings API usage
CONFIG_SYSTEM_WORKQUEUE_STACK_SIZE=2048

# BLE
CONFIG_BT=y
CONFIG_LOG=y
CONFIG_BT_LOG_LEVEL_INF=y
CONFIG_BT_SMP=y
CONFIG_BT_PERIPHERAL=y
CONFIG_BT_DIS=y
CONFIG_BT_ATT_PREPARE_COUNT=5
CONFIG_BT_BAS=y
CONFIG_BT_PRIVACY=y
CONFIG_BT_DEVICE_NAME="Vitaltrace Test"
CONFIG_BT_DEVICE_APPEARANCE=833
CONFIG_BT_DEVICE_NAME_DYNAMIC=y
CONFIG_BT_DEVICE_NAME_MAX=65
CONFIG_BT_HCI=y

CONFIG_BT_KEYS_OVERWRITE_OLDEST=y
CONFIG_BT_SETTINGS=y
CONFIG_FLASH=y
CONFIG_FLASH_MAP=y
CONFIG_NVS=y
CONFIG_SETTINGS=y

CONFIG_NANOPB=y
```

## src/main.c
```c
/******************************************************************************
 * @file:   main.c
 * @brief:  Application main entry point
 * @author: Antonia Workman
 * @date:   2026-05-12
 *****************************************************************************/


#include <zephyr/types.h>
#include <stddef.h>
#include <string.h>
#include <errno.h>
#include <zephyr/sys/byteorder.h>
#include <zephyr/kernel.h>

#include <zephyr/settings/settings.h>
#include <zephyr/logging/log.h>

#include <zephyr/bluetooth/bluetooth.h>
#include <zephyr/bluetooth/hci.h>
#include <zephyr/bluetooth/conn.h>
#include <zephyr/bluetooth/uuid.h>
#include <zephyr/bluetooth/gatt.h>
#include <zephyr/bluetooth/gap.h>

#include "battery.h"
#include "ble.h"
#include "heart_rate.h"

LOG_MODULE_REGISTER(main, LOG_LEVEL_INF);

int main(void)
{
	int err;

	err = bt_enable(NULL);
	if (err) {
		LOG_ERR("Bluetooth init failed (err %d)\n", err);
		return 0;
	}

	bt_ready();

	while (1) {
		k_sleep(K_SECONDS(1));
	}
	return 0;
}
```

## include/battery.h
```c
/******************************************************************************
 * @file:   battery.h
 * @author: Antonia Workman
 * @date:   2026-05-12
 *****************************************************************************/


#ifndef BATTERY_H
#define BATTERY_H

#include <zephyr/kernel.h>
#include <zephyr/bluetooth/services/bas.h>

#define BATTERY_UPDATE_INTERVAL_SEC   5u

void battery_init(void);

#endif /* BATTERY_H */
```

## include/ble.h
```c
/******************************************************************************
 * @file:   ble.h
 * @author: Antonia Workman
 * @date:   2026-05-12
 *****************************************************************************/


#ifndef BLE_H
#define BLE_H

#include <zephyr/bluetooth/bluetooth.h>
#include <zephyr/bluetooth/gatt.h>
#include <zephyr/types.h>
#include <stddef.h>
#include <string.h>
#include <errno.h>
#include <zephyr/sys/byteorder.h>
#include <zephyr/kernel.h>

#include <zephyr/settings/settings.h>

#define HR_SERVICE_UUID BT_UUID_128_ENCODE(0x89565150, 0x1c0d, 0x4a5e, 0x8467, 0x2bf671624c10)
#define HR_DATA_UUID BT_UUID_128_ENCODE(0x89565150, 0x1c0d, 0x4a5e, 0x8467, 0x2bf671624c11)
#define HR_CTRL_UUID BT_UUID_128_ENCODE(0x89565150, 0x1c0d, 0x4a5e, 0x8467, 0x2bf671624c12)

#define BT_UUID_HR_SERVICE              BT_UUID_DECLARE_128(HR_SERVICE_UUID)
#define BT_UUID_HR_DATA                 BT_UUID_DECLARE_128(HR_DATA_UUID)
#define BT_UUID_HR_CTRL                 BT_UUID_DECLARE_128(HR_CTRL_UUID)

void bt_ready(void);

#endif /* BLE_H */
```

## include/heart_rate.h
```c
/******************************************************************************
 * @file:   heart_rate.h
 * @author: Antonia Workman
 * @date:   2026-05-12
 *****************************************************************************/

#ifndef HEART_RATE_H
#define HEART_RATE_H

#define STREAM_STACK_SIZE   1024
#define STREAM_PRIORITY     5

/** Control codes written by the central */
typedef enum {
    MY_SERVICE_CTRL_STOP  = 0x00,
    MY_SERVICE_CTRL_START = 0x01,
} my_service_ctrl_t;

int hr_service_init(void);

#endif
```

## include/heart_rate_pb.h
```c
/* Automatically generated nanopb header */
/* Generated by nanopb-0.4.9.1 */

#ifndef PB_HEART_RATE_PB_H_INCLUDED
#define PB_HEART_RATE_PB_H_INCLUDED
#include <pb.h>

#if PB_PROTO_HEADER_VERSION != 40
#error Regenerate this file with the current version of nanopb generator.
#endif

/* Struct definitions */
typedef struct _Notify {
    uint32_t index; /* packet sequence number */
    pb_byte_t hr_buffer[10]; /* data payload */
} Notify;


#ifdef __cplusplus
extern "C" {
#endif

/* Initializer values for message structs */
#define Notify_init_default                      {0, {0}}
#define Notify_init_zero                         {0, {0}}

/* Field tags (for use in manual encoding/decoding) */
#define Notify_index_tag                         1
#define Notify_hr_buffer_tag                     2

/* Struct field encoding specification for nanopb */
#define Notify_FIELDLIST(X, a) \
X(a, STATIC,   SINGULAR, UINT32,   index,             1) \
X(a, STATIC,   SINGULAR, FIXED_LENGTH_BYTES, hr_buffer,         2)
#define Notify_CALLBACK NULL
#define Notify_DEFAULT NULL

extern const pb_msgdesc_t Notify_msg;

/* Defines for backwards compatibility with code written before nanopb-0.4.0 */
#define Notify_fields &Notify_msg

/* Maximum encoded size of messages (where known) */
#define HEART_RATE_PB_H_MAX_SIZE                 Notify_size
#define Notify_size                              18

#ifdef __cplusplus
} /* extern "C" */
#endif

#endif
```

## src/battery.c
```c
/******************************************************************************
 * @file:   battery.c
 * @brief:  Defines battery module with simulated discharge functionality.
 * @author: Antonia Workman
 * @date:   2026-05-12
 *****************************************************************************/


/* --- Includes ----------------------------------------------------------- */
#include <zephyr/kernel.h>
#include <zephyr/logging/log.h>
#include "battery.h"

LOG_MODULE_REGISTER(battery, LOG_LEVEL_INF);


/* --- Private Function Prototypes ---------------------------------------- */
static void bas_notify_handler(struct k_work *work);


/* --- Private Defines/Macros --------------------------------------------- */
static K_WORK_DELAYABLE_DEFINE(battery_work, bas_notify_handler);


/* --- Public Function Definitions ---------------------------------------- */
/** 
* @brief  Initialse battery level and start work scheduler for BLE updates and battery discharge
*/
void battery_init(void)
{
    bt_bas_set_battery_level(100U);
    k_work_schedule(&battery_work, K_SECONDS(BATTERY_UPDATE_INTERVAL_SEC));
}


/* --- Private Function Definitions --------------------------------------- */
/** 
* A function to simulate battery discharge, losing 1% every 5s 
* and to send battery level notifications to the central device
*/ 
static void bas_notify_handler(struct k_work *work)
{
	uint8_t battery_level = bt_bas_get_battery_level();

	if (battery_level == 0U) {
        battery_level = 100U;
    } else {
        battery_level--;
    }

	bt_bas_set_battery_level(battery_level);

    k_work_schedule(&battery_work, K_SECONDS(BATTERY_UPDATE_INTERVAL_SEC));
}
```

## src/ble.c
```c
/******************************************************************************
 * @file:   ble.c
 * @brief:  File for defining BLE services and advertising, connection and disconnection functionality.
 * @author: Antonia Workman
 * @date:   2026-05-12
 *****************************************************************************/


/* --- Includes ----------------------------------------------------------- */
#include <zephyr/kernel.h>
#include <zephyr/logging/log.h>
#include <zephyr/bluetooth/bluetooth.h>
#include <zephyr/bluetooth/gatt.h>
#include <zephyr/sys/byteorder.h>
#include <zephyr/bluetooth/services/bas.h>
#include "ble.h"
#include "battery.h"
#include "heart_rate.h"

LOG_MODULE_REGISTER(ble, LOG_LEVEL_INF);

/* --- Private Function Prototypes ---------------------------------------- */
static void connected(struct bt_conn *conn, uint8_t err);
static void disconnected(struct bt_conn *conn, uint8_t reason);


/* --- Private Types ------------------------------------------------------ */
BT_CONN_CB_DEFINE(conn_callbacks) = {
	.connected = connected,
	.disconnected = disconnected,
};

/* Scan response with device name */
static const struct bt_data sd[] = {
    BT_DATA(BT_DATA_NAME_COMPLETE, CONFIG_BT_DEVICE_NAME, sizeof(CONFIG_BT_DEVICE_NAME) - 1),
};

/* Standard Battery Service, in advertising data */
static const struct bt_data ad[] = {
    BT_DATA_BYTES(BT_DATA_FLAGS, (BT_LE_AD_GENERAL | BT_LE_AD_NO_BREDR)),
    BT_DATA_BYTES(BT_DATA_UUID16_ALL,
                  BT_UUID_16_ENCODE(BT_UUID_BAS_VAL)), /* 0x180F */
};


/* --- Public Function Definitions ---------------------------------------- */
/** 
* @brief  Function to check the proper functioning of the bluetooth module and initialise 
*         bluetooth-dependent modules
*/
void bt_ready(void)
{
	int err;

	LOG_INF("Bluetooth initialized\n");

	if (IS_ENABLED(CONFIG_SETTINGS)) {
		settings_load();
	}

	err = bt_le_adv_start(BT_LE_ADV_CONN_FAST_1, ad, ARRAY_SIZE(ad), sd, ARRAY_SIZE(sd));
	if (err) {
		LOG_INF("Advertising failed to start (err %d)\n", err);
		return;
	}

	LOG_INF("Advertising successfully started\n");

	/* Start the heart rate service */
    hr_service_init();

    /* Initiate the standard battery service */
	battery_init();
}


/* --- Callbacks ---------------------------------------- */
static void connected(struct bt_conn *conn, uint8_t err)
{
    if (err) {
        LOG_ERR("Connection failed (err %u)", err);
        return;
    }
    LOG_INF("Connected");
}

static void disconnected(struct bt_conn *conn, uint8_t reason)
{
	LOG_INF("Disconnected");

    int err = bt_le_adv_start(BT_LE_ADV_CONN_FAST_1, ad, ARRAY_SIZE(ad),
                               sd, ARRAY_SIZE(sd));
    if (err) {
        LOG_ERR("Advertising failed to restart (err %d)", err);
    }
}
```

## src/heart_rate.c
```c
/******************************************************************************
 * @file:   heart_rate.c
 * @brief:  File for defining the heart rate BLE callbacks and module functionality.
 * @author: Antonia Workman
 * @date:   2026-05-12
 *****************************************************************************/


/* --- Includes ----------------------------------------------------------- */
#include <zephyr/logging/log.h>
#include <zephyr/bluetooth/gatt.h>
#include <pb_encode.h>
#include "heart_rate.h"
#include "heart_rate_pb.h"
#include "ble.h"

LOG_MODULE_REGISTER(heart_rate, LOG_LEVEL_INF);

/* --- Private Function Prototypes ---------------------------------------- */
static void stream_thread_fn(void *a, void *b, void *c);
static int hr_service_notify(Notify *msg);
static void hr_data_ccc_changed(const struct bt_gatt_attr *attr, uint16_t value);
static int hr_ctrl_read_cb(struct bt_conn *conn,
                             const struct bt_gatt_attr *attr,
                             void *buf, uint16_t len, uint16_t offset);
static int hr_ctrl_write_cb(struct bt_conn *conn,
                              const struct bt_gatt_attr *attr,
                              const void *buf, uint16_t len,
                              uint16_t offset, uint8_t flags);



/* --- Private Defines/Macros --------------------------------------------- */
#define STREAM_INTERVAL_MS      100U

K_THREAD_DEFINE(stream_thread,
                STREAM_STACK_SIZE,
                stream_thread_fn,
                NULL, NULL, NULL,
                STREAM_PRIORITY,
                0,
                0); 

/** Custom Heart Rate Service */
BT_GATT_SERVICE_DEFINE(hr_service,
    BT_GATT_PRIMARY_SERVICE(BT_UUID_HR_SERVICE),
    BT_GATT_CHARACTERISTIC(BT_UUID_HR_DATA,
                           BT_GATT_CHRC_NOTIFY,
                           BT_GATT_PERM_NONE,
                           NULL, NULL, NULL),
    BT_GATT_CCC(hr_data_ccc_changed, BT_GATT_PERM_READ | BT_GATT_PERM_WRITE),
    BT_GATT_CHARACTERISTIC(BT_UUID_HR_CTRL,
                           BT_GATT_CHRC_READ | BT_GATT_CHRC_WRITE | BT_GATT_CHRC_WRITE_WITHOUT_RESP,
                           BT_GATT_PERM_READ | BT_GATT_PERM_WRITE,
                           hr_ctrl_read_cb, hr_ctrl_write_cb, NULL),
);

/* --- Private Variables -------------------------------------------------- */
static bool streaming_ctrl = false;
static bool notify_enabled = false;
static uint32_t index = 0;
static uint8_t encode_buf[Notify_size];


/* --- Public Function Definitions ---------------------------------------- */
/** 
* @brief Initialises the heart rate module by setting all control values to 0.
*        To be called from BLE module after bluetooth initialisation
* 
* @retval 0 for success
*/
int hr_service_init(void)
{
    streaming_ctrl = false;
    notify_enabled = false;
    LOG_INF("Heart rate service initialised");
    return 0;
}

/** 
* @brief Read if streaming is turned on/off from outside the heart rate module
* 
* @retval 0 streaming disabled, 1 streaming enabled
*/
bool is_hr_streaming(void)
{
    return streaming_ctrl && notify_enabled;
}

/** 
* @brief Sets the streaming control value to turn heart rate streaming on/off
* 
* @param ctrl_val Boolean value to set streaming to on (value = 1) or off (value = 0)
*/
void hr_ctrl_set(bool ctrl_val)
{
    streaming_ctrl = ctrl_val;
}


/* --- Private Function Definitions --------------------------------------- */
static void stream_thread_fn(void *a, void *b, void *c)
{
    while (1) {
        if (is_hr_streaming() == true) {
            Notify msg = Notify_init_zero;
            msg.index = index++;

            /** Fill buffer with fake test data for now */
            for (int i = 0; i < 10; i++) {
                msg.hr_buffer[i] = i;
            }

            hr_service_notify(&msg);
        }
        k_msleep(STREAM_INTERVAL_MS);
    }
}

static int hr_service_notify(Notify *msg)
{
    if (notify_enabled != true) {
        return -EACCES;  /** Permission denied, central notifications are off */
    }
    if (streaming_ctrl != true) {
        return -EBUSY;   /**  streaming not started by central */
    }

    pb_ostream_t stream = pb_ostream_from_buffer(encode_buf, sizeof(encode_buf));

    if (!pb_encode(&stream, Notify_fields, msg)) {
        LOG_ERR("pb_encode failed: %s", stream.errmsg);
        return -EINVAL;
    }

    int err = bt_gatt_notify(NULL, &hr_service.attrs[1],
                             encode_buf, stream.bytes_written);
    if (err) {
        LOG_ERR("Notify failed (err %d)", err);
    }

    return err;
}

/* --- Callbacks -------------------------------------------------- */
/** Callback for read request from central device of streaming status */
static int hr_ctrl_read_cb(struct bt_conn *conn,
                             const struct bt_gatt_attr *attr,
                             void *buf, uint16_t len, uint16_t offset)
{
    LOG_INF("Data characteristic read: %d", streaming_ctrl);
    return bt_gatt_attr_read(conn, attr, buf, len, offset, &streaming_ctrl, sizeof(streaming_ctrl));
}

/** Callback for write from central device */
static int hr_ctrl_write_cb(struct bt_conn *conn,
                              const struct bt_gatt_attr *attr,
                              const void *buf, uint16_t len,
                              uint16_t offset, uint8_t flags)
{
    if (len != 1U) {
        LOG_WRN("Control write: unexpected length %u", len);
        return BT_GATT_ERR(BT_ATT_ERR_INVALID_ATTRIBUTE_LEN);
    }

    uint8_t opcode = *((uint8_t *)buf);

    switch (opcode) {
    case MY_SERVICE_CTRL_START:
        streaming_ctrl = true;
        LOG_INF("Streaming started");
        break;
    case MY_SERVICE_CTRL_STOP:
        streaming_ctrl = false;
        LOG_INF("Streaming stopped");
        break;
    default:
        LOG_WRN("Unknown control command: 0x%02X", opcode);
        return BT_GATT_ERR(BT_ATT_ERR_NOT_SUPPORTED);
    }

    return len;
}

/** Indicates when notifications are switched on/off by the central device 
* This alone does not turn streaming on/off since that is handled by the HR_CTRL characteristic */
static void hr_data_ccc_changed(const struct bt_gatt_attr *attr, uint16_t value)
{
    notify_enabled = (value == BT_GATT_CCC_NOTIFY);
    LOG_INF("Data notifications %s", notify_enabled ? "enabled" : "disabled");
}
```

## src/heart_rate_pb.c
```c
/* Automatically generated nanopb constant definitions */
/* Generated by nanopb-0.4.9.1 */

#include "heart_rate_pb.h"
#if PB_PROTO_HEADER_VERSION != 40
#error Regenerate this file with the current version of nanopb generator.
#endif

PB_BIND(Notify, Notify, AUTO)
```
